/dts-v1/;

/* Generated by dts-build for project "DemoBoard" */
/* profile: 968375GWO_WL25DX_WLMLO */
/* refboard: 968375GO */

#include "inc/68375.dtsi"

/ {
    model = "DemoBoard";
    compatible = "brcm,bcm968375";
};

/ {
    memory_controller {
        memcfg = <(BP1_DDR_MCBSEL_FORMAT_VER1 | BP1_DDR_TYPE_LPDDR4 | BP1_DDR_SPEED_2133_36_39_39 | BP1_DDR_WIDTH_32BIT | BP1_DDR_TOTAL_SIZE_16Gb | BP1_DDR_SSC_CONFIG_1)>;
    };
};

/*
 * TODO: network topology input rows
 * - port_xgphy0: role=LAN, source=, phy_handle=xphy0, phy_mode=xfi, present=true
 * - port_wan: role=WAN, source=serdes0, phy_handle=, phy_mode=serdes, present=true
 */

/*
 * TODO: GPIO / LED input rows
 * - gpio:reset_button signal=RESET#, pin_or_gpio=gpioc 2, polarity=active_low
 * - led:wan_led signal=WAN, pin_or_gpio=led14, polarity=active_low
 */

/*
 * Next editing targets
 * - Translate network rows into &switch0, &mdio_bus, &wan_serdes, and related nodes.
 * - Translate GPIO/LED rows into buttons, LED mappings, and pinctrl/GPIO bindings.
 * - Fill any missing manifest values and replace TODO blocks with board-specific DTS nodes.
 */
